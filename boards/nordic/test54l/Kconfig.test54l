## boards/nordic/test54l/Kconfig.test54l
```kconfig
config BOARD_TEST54L
	select SOC_NRF54L15_CPUAPP if BOARD_TEST54L_NRF54L15_CPUAPP
	select SOC_NRF54L15_CPUFLPR if \
		BOARD_TEST54L_NRF54L15_CPUFLPR || \
		BOARD_TEST54L_NRF54L15_CPUFLPR_XIP
```
